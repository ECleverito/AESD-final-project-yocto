## build/conf/bblayers.conf
```bitbake
# POKY_BBLAYERS_CONF_VERSION is increased each time build/conf/bblayers.conf
# changes incompatibly
POKY_BBLAYERS_CONF_VERSION = "2"

BBPATH = "${TOPDIR}"
BBFILES ?= ""

BBLAYERS ?= " \
  /home/erich/CU_Fall_22/AESD/FinalProject/yocto-tegra/meta-tegra \
  /home/erich/CU_Fall_22/AESD/FinalProject/yocto-tegra/poky/meta \
  /home/erich/CU_Fall_22/AESD/FinalProject/yocto-tegra/poky/meta-poky \
  /home/erich/CU_Fall_22/AESD/FinalProject/yocto-tegra/poky/meta-yocto-bsp \
  "
```
